## firmware/main/Kconfig.projbuild
```kconfig
menu "myPlaud"

config MYPLAUD_SCREEN_TEST
    bool "Screen test build (no USB audio)"
    default n
    help
        Initialise only the LCD, draw a test pattern and log to the console.
        Used to debug the display without the USB audio device taking the USB port.

config MYPLAUD_BOOT_ONLY
    bool "Boot-only build: app_main only logs (bisecting boot problems)"
    default n

config MYPLAUD_FIFO_LOG2
    int "Upper limit of the recorder FIFO per stream, log2 of samples (17 = 131072 samples = 2.7 s at 48 kHz)"
    range 13 17
    default 17
    help
        The recorder takes as much of the free RAM as it can for the FIFOs, up to this size per stream
        (the size is logged and written to the .TXT).

config MYPLAUD_HEADER_SYNC_SECONDS
    int "Seconds between WAV header rewrites of one file (ME and OT alternate, so a sync happens every half of it)"
    range 2 120
    default 20
    help
        Bounds the data lost on power loss; each sync stalls the SD card for a moment.

config MYPLAUD_SD_FREQ_KHZ
    int "SD card SPI clock in kHz (falls back to 20000 when the card does not mount)"
    range 10000 40000
    default 20000
    help
        The card is tried at this clock first. 20000 is the proven rate; 40000 (SD high speed) failed to
        mount on the test card, so it is opt-in. The mount is retried at 20 MHz if it fails, and the clock actually used is written to the .TXT (sd_khz).

config MYPLAUD_BEEPS_WHILE_RECORDING
    bool "Volume ticks and warning beeps while recording"
    default n
    help
        The start and stop beeps are played while the recorder is not writing, so the microphone never
        hears them. Volume ticks and warning beeps would be played during a recording and the speaker is
        next to the microphone: off until it is shown that they stay out of the ME file.

endmenu
```
